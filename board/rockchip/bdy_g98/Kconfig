## board/rockchip/bdy_g98/Kconfig
```kconfig
if TARGET_BDY_G98_RK3588

config SYS_BOARD
	default "bdy_g98"

config SYS_VENDOR
	default "rockchip"

config SYS_CONFIG_NAME
	default "rk3588_common"

endif
```
